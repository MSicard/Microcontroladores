;*********************************************
;   DECLARACION DE VARIABLES                 *
;*********************************************
		HH 		EQU 	20H
		MM		EQU		21H
		SS		EQU		22H
		COUNT 	EQU 	23H
		TRANS	EQU		24H
		SEGM	EQU		25H
		CERO	EQU		26H
		UNO		EQU		27H
		DOS		EQU		28H
		TRES	EQU		29H
		CUATRO	EQU		2AH
		CINCO	EQU		2BH
		SEIS	EQU		2CH
		SIETE	EQU		2DH
		OCHO	EQU		2EH
		NUEVE	EQU		2FH; ASIGNAMOS SEGMENTOSMOV
		AH		EQU		30H;
		AM		EQU		31H;
		AS		EQU		32H;
		RA_SW	EQU		P3.4  ; SABER SI MOSTRAMOS EL RELOJ O LA ALARMA
		BUZZER	EQU		P3.0  ; PUERTO DEL BUZZER
		B_MM	EQU		P3.2  ;BUTTON DE MINUTOS
		B_HH	EQU		P3.3  ;BUTTON DE HORAS
			
;*********************************************
;   VECTORES DEL PROGRAMA		             *
;*********************************************
				ORG		0000H
				LJMP 	PRINCIPAL
				ORG		0003H
				LJMP 	BUTTON_MM
				ORG 	0013H
				LJMP	BUTTON_HH
				ORG		000BH
				LJMP 	RELOJ
				ORG 	001BH
				LJMP	TRANSISTORES
				
;*********************************************
;   DEBOUNCER						         *
;*********************************************

DEBOUNCE_DELAY:	MOV R7,#30D

LL_DEBOUNCE_DELAY:	MOV R6,#0FFH
					DJNZ R6,$
					DJNZ R7,LL_DEBOUNCE_DELAY
					RET
					
;*********************************************
;   INTERRUPCION EXT0 (MINUTOS)	             *
;*********************************************
BUTTON_MM:		ACALL 	DEBOUNCE_DELAY			;ESPERA 30 MILISEGUNDOS
				JB		B_MM,FINALMM			;COMPARAR SI EL BOTON SE ESTA SOLTANDO 
				
COMPARATORM:	JB 		RA_SW, ALARMINC_MM		
				INC		MM
				MOV 	A, MM
				CJNE 	A, #60D, FINALMM
				MOV		MM, #00H
				SJMP	FINALMM

ALARMINC_MM:	INC 	AM
				MOV		A, AM
				CJNE 	A, #60D, FINALMM
				MOV		AM, #00H
				
FINALMM:		JNB		B_MM, $				;ESPERA A LA SIGUIENTE INTERRUPCIÓN
				RETI


					
;*********************************************
;         INTERRUPCION EXT1 (HORAS)          *
;*********************************************
BUTTON_HH:		ACALL 	DEBOUNCE_DELAY		;ESPERA 30 MILISEGUNDOS 
				JB		B_HH,FINALHH 		;COMPARAR SI EL BOTON SE ESTA SOLTANDO
				
COMPARATORH:	JB 		RA_SW, ALARMINC_HH		
				INC		HH
				MOV 	A, HH
				CJNE 	A, #24D, FINALHH
				MOV		HH, #00H
				SJMP	FINALHH

ALARMINC_HH:	INC 	AH
				MOV		A, AH
				CJNE 	A, #24D, FINALHH
				MOV		AH, #00H
					
FINALHH:		JNB 	B_HH, $					;ESPERA A LA SIGUIENTE INTERRUPCIÓN
				RETI

;*********************************************
;   INTERRUPCIÓN DE RELOJ T0                 *
;*********************************************
RELOJ:			INC		COUNT					;AUMENTAMOS COUNT
				MOV 	TH0,#HIGH(-49999)		;VALOR DE RECARGA PARA EL TEMPORIZADOR0 EN H
				MOV 	TL0,#LOW(-49999)		;VALOR DE RECARGA PARA EL TEMPORIZADOR0	EN L
				CLR		TF0						;LIMPIAR DESBORDAMIENTO/FLAG
				MOV 	R1, COUNT
				CJNE 	R1, #20D, FINALRELOJ	;REVISAMOS SI YA LLEGUÉ A 20 CUENTAS
				INC 	SS						;EL COUNT YA FUE 200, SE AUMENTA 1
				MOV 	COUNT, #00H				;SE REINICIA EL COUNT
				MOV 	R1, SS
				CJNE 	R1, #60D, FINALRELOJ	;SI HAY 60 SEGUNDOS
				SETB 	BUZZER					;RESET AL BUZZER
				INC 	MM						;INCREMENTO MM
				MOV 	SS, #00H 				;SE REINICIA SS	
				MOV 	R1, MM
				CJNE 	R1, #60D, COMPALARMA	;SI HAY 60 MINUTOS
				INC 	HH						;INCREMENTO HH
				MOV 	MM, #00H				;SE REINICIA MM
				MOV 	R1, HH
				CJNE 	R1, #24D, COMPALARMA	;YA PASÓ UN DÍA
				MOV 	HH, #00H				;LAS HORAS SE PONE EN 0
COMPALARMA:		MOV		A, AM
				CJNE 	A, MM, FINALRELOJ
				MOV		A, AH
				CJNE	A, HH, FINALRELOJ
				CLR 	BUZZER
FINALRELOJ:		RETI

		
;*********************************************
;   INTERRUPCIÓN DE TRANSISTORES  T1         *
;*********************************************

; AL INICIO VERIFICAMOS SI EL SWITCH ESTÁ EN RELOJ O EN ALARMA. 
;DEPENDIENDO DE ESO LOS REGISTROS DE R3 A R5 SE IRÁN CAMBIANDO CON LOS DATOS
TRANSISTORES:	JB 		RA_SW, ALARMADATA
				MOV 	R3, SS					; MOVER LOS SS AL R3
				MOV 	R4, MM					; MOVER LOS MM AL R4
				MOV		R5, HH					; MOVER LAS HH AL R5
				SJMP 	CONTINUE
ALARMADATA:		MOV 	R3, AS					; MOVER LOS AS AL R3
				MOV		R4, AM					; MOVER LOS AM AL R4
				MOV		R5, AH					; MOVER LOS AH AL R5
CONTINUE:		CLR		TF1						; LIMPIAR FLAG
				MOV 	TH1,#HIGH(-20000)		;VALOR DE RECARGA PARA EL TEMPORIZADOR1 EN H
				MOV 	TL1,#LOW(-20000)		;VALOR DE RECARGA PARA EL TEMPORIZADOR1 EN L
				MOV 	P1, TRANS  				;MANDAR BARRIDO A PUERTO 0A
				MOV 	B, #10D					; B = 10
				MOV 	R2, TRANS
SEG1:			CJNE 	R2, #11111110B, SEG2	; TRANSISTOR EN 1
				MOV 	A, R3 					; MOVER SS AL ACUMULADOR 
				SJMP 	LOWTRANS				; TRANSITOR LOW
SEG2:			CJNE 	R2, #11111101B, SEG3	; TRANSISTOR EN 2 
				MOV 	A, R3 					; MOVER SS AL ACUMULADOR 
				SJMP 	HIGHTRANS				; TRANSITOR LOW
SEG3:			CJNE 	R2, #11111011B, SEG4	; TRANSISTOR EN 3 
				MOV 	A, R4 					; MOVER SS AL ACUMULADOR 
				SJMP 	LOWTRANS				; TRANSITOR LOW
SEG4:			CJNE 	R2, #11110111B, SEG5	; TRANSISTOR EN 4 
				MOV 	A, R4 					; MOVER SS AL ACUMULADOR 
				SJMP 	HIGHTRANS				; TRANSITOR LOW
SEG5:			CJNE 	R2, #11101111B, SEG6	; TRANSISTOR EN 5 
				MOV 	A, R5 					; MOVER SS AL ACUMULADOR 
				SJMP 	LOWTRANS				; TRANSITOR LOW
SEG6:			CJNE 	R2, #11011111B, SEG1	; TRANSISTOR EN 6
				MOV 	A, R5 					; MOVER SS AL ACUMULADOR 
				SJMP 	HIGHTRANS				; TRANSITOR LOW
			
LOWTRANS:		DIV 	AB						; DIVIDIR ENTRE 10 LO QUE HAY
				MOV 	A, B					; MOVER EL RESIDUO A A
				SJMP 	GOTABLE					; IR A HIHG
HIGHTRANS:		DIV 	AB						; DIVIDIR 
GOTABLE: 		MOV 	R1, #26H
				ADD		A, R1					; ENCONTRAR A QUE DIRECCIÓN BUSCAR
				MOV 	R1, A
				MOV 	A, @R1					; BUSCAR EN LA TABLA
				MOV		P2, A 					; PASAR ACC AL P2
				MOV 	A, TRANS				; TRANSISTOR AL ACC
				CJNE	A, #11011111B, RLFUN	; TENEMOS QUE HACER TRES MOVIMIENTOS
				RL 		A						; MOVER A LA IZQUIERDA
				RL 		A						; MOVER A LA IZQUIERDA
RLFUN:			RL		A						; MOVER A LA IZQUIERDA
				MOV 	TRANS, A				; ACC AL TRANS
				RETI
;*********************************************
;   INICIALIZACIÓN DE VARIABLES               *
;*********************************************
INICIALIZACION:	MOV 	HH,#12D                ; INICIAMOS VALORES EN 0 Y 12 PARA LAS HORAS
				MOV		MM,#00H
				MOV 	SS,#00H
				MOV		AH, #00D				; INICIAMOS VALORES EN ALARMA FUERA DEL RANGO
				MOV		AM, #00H				;
				MOV		AS, #00H
				MOV		COUNT,#00H
				MOV		CERO, #11000000B
				MOV		UNO, #11111001B
				MOV		DOS, #10100100B
				MOV		TRES, #10110000B
				MOV 	CUATRO, #10011001B
				MOV		CINCO, #10010010B
				MOV 	SEIS, #10000010B
				MOV		SIETE, #11111000B
				MOV		OCHO, #10000000B
				MOV		NUEVE, #10011000B 
				MOV 	TRANS,#11111110B
				SETB 	BUZZER					;DEJA EL BUZZER EN 1 PARA QUE NO PRENDA
				MOV 	TH0,#HIGH(-49999)		;VALOR DE RECARGA PARA EL TEMPORIZADOR0 EN H
				MOV 	TL0,#LOW(-49999)		;VALOR DE RECARGA PARA EL TEMPORIZADOR0	EN L
				MOV 	TH1,#HIGH(-20000)				;VALOR DE RECARGA PARA EL TEMPORIZADOR1 EN H
				MOV 	TL1,#LOW(-20000)				;VALOR DE RECARGA PARA EL TEMPORIZADOR1 EN L
				MOV 	TMOD,#00000001B
				SETB 	TR0						;INICIALIZA EL TEMPORIZADOR0
				SETB 	TR1						;INICIALIZA EL TEMPORIZADOR1
				MOV 	IE, #8FH				;HABILITA INTERRUPCIONES DEL TEMPORIZADOR 		
				SETB 	IT1						;HABILITA FLANCO DE BAJADA DE INTERRUPCIONES EXTERNAS
				SETB	IT0
				RET
;*********************************************
;   PRINCIPAL				                 *
;*********************************************
PRINCIPAL:		ACALL 	INICIALIZACION
				SJMP 	$; HAZ NADA
				END